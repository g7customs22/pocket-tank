## firmware/main/Kconfig.projbuild
```kconfig
menu "pocket-tank"
    config POCKET_TANK_WAVESHARE_349_V1
        bool "Waveshare ESP32-S3-Touch-LCD-3.49 V1 (experimental)"
        default n
        help
            V1 only: AXS15231B, reset GPIO21, backlight GPIO8.
            Fits the unchanged 448x368 tank into a 209x172 viewport.
            Battery percentage is unavailable; IMU auto-flip awaits calibration.
    config POCKET_TANK_WIFI_TIME_RECOVERY
        bool "Recover an invalid RTC over configured Wi-Fi"
        depends on POCKET_TANK_WAVESHARE_349_V1 && ESP_WIFI_ENABLED
        default y
        help
            One bounded attempt after clock loss. No unknown offline credit.
            Credentials are configured over USB and stored separately from tanks.
    config POCKET_TANK_DISPLAY_SH8601
        bool "Drive the Waveshare 1.8in AMOLED (SH8601 / CO5300 over QSPI)"
        depends on !POCKET_TANK_WAVESHARE_349_V1
        default n
        help
            Enable for the real board. Off = stub display port (QEMU / compile-only).
    config POCKET_TANK_TOUCH_FT3168
        bool "Read the FT3168 capacitive touch (taps / holds)"
        depends on !POCKET_TANK_WAVESHARE_349_V1
        default n
    config POCKET_TANK_AUDIO_ES8311
        bool "Play the sound bank through the ES8311 codec + NS4150B amp (I2S)"
        default n
        help
            Enable for the real board (docs/AUDIO.md). Off = stub audio port: cues compile, nothing plays.
    config POCKET_TANK_NO_PIE
        bool "Disable the PIE SIMD inference kernel (scalar dot products)"
        default n
        help
            Enable for a QEMU build if the emulator lacks ESP32-S3 PIE support.
endmenu
```
